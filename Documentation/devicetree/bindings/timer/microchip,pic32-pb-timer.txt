## drivers/iio/trigger/Kconfig
```kconfig
#
# Industrial I/O standalone triggers
#
# When adding new entries keep the list in alphabetical order

menu "Triggers - standalone"

config IIO_INTERRUPT_TRIGGER
	tristate "Generic interrupt trigger"
	help
	  Provides support for using an interrupt of any type as an IIO
	  trigger.  This may be provided by a gpio driver for example.

	  To compile this driver as a module, choose M here: the
	  module will be called iio-trig-interrupt.

config IIO_SYSFS_TRIGGER
	tristate "SYSFS trigger"
	depends on SYSFS
	select IRQ_WORK
	help
	  Provides support for using SYSFS entries as IIO triggers.
	  If unsure, say N (but it's safe to say "Y").

	  To compile this driver as a module, choose M here: the
	  module will be called iio-trig-sysfs.

config IIO_PIC32_TIMER_TRIGGER
	tristate "Microchip PIC32 Periodic Timer trigger"
	depends on MACH_PIC32
	help
	  Provides support for using an PIC32 pbtimer as an IIO trigger.

endmenu
```

## drivers/net/can/microchip/Kconfig
```kconfig
menu "Microchip PIC32 CAN Controller"
	depends on MIPS

config CAN_PIC32MZDA
        tristate "Microchip PIC32MZDA CAN Controller"
        ---help---
	This driver adds support for the PIC32MZDA Chip.
endmenu
```

## drivers/net/ethernet/microchip/Kconfig
```kconfig
#
# Microchip network device configuration
#

config NET_VENDOR_MICROCHIP
	bool "Microchip devices"
	default y
	---help---
	  If you have a network (Ethernet) card belonging to this class, say Y.

	  Note that the answer to this question doesn't directly affect the
	  kernel: saying N will just cause the configurator to skip all
	  the questions about Microchip cards. If you say Y, you will be asked
	  for your specific card in the following questions.

if NET_VENDOR_MICROCHIP

config PIC32EC
	tristate "PIC32 Ethernet Controller support"
	depends on MACH_PIC32
	default y
	select PHYLIB
	---help---
	  The PIC32 ethernet controller is found on the Microchip PIC32
	  microcontrollers. Say Y to include support for the PIC32 ethernet
	  controller.

	  To compile this driver as a module, choose M here: the module
	  will be called pic32ec.

config ENC28J60
	tristate "ENC28J60 support"
	depends on SPI
	select CRC32
	---help---
	  Support for the Microchip EN28J60 ethernet chip.

	  To compile this driver as a module, choose M here. The module will be
	  called enc28j60.

config ENC28J60_WRITEVERIFY
	bool "Enable write verify"
	depends on ENC28J60
	---help---
	  Enable the verify after the buffer write useful for debugging purpose.
	  If unsure, say N.

endif # NET_VENDOR_MICROCHIP
```

## drivers/net/ethernet/pic32/Kconfig
```kconfig
#
# PIC32C ethernet controller configuration
#

config NET_PIC32
	bool "Microchip PIC32 devices"
	depends on MACH_PIC32
	default y
	---help---
	  If you have a network (Ethernet) card belonging to this class, say Y.
	  Make sure you know the name of your card. Read the Ethernet-HOWTO,
	  available from <http://www.tldp.org/docs.html#howto>.

	  If unsure, say Y.

	  Note that the answer to this question doesn't directly affect the
	  kernel: saying N will just cause the configurator to skip all
	  the remaining PIC32 network card questions. If you say Y, you will be
	  asked for your specific card in the following questions.

if NET_PIC32

config PIC32_ETHER
	tristate "Microchip PIC32 Ethernet support"
	default y
	select PHYLIB
	---help---
	  If you have a PIC32 and want to use ethernet, say Y
	  and read the Ethernet-HOWTO, available from
	  <http://www.tldp.org/docs.html#howto>.

endif
```

## sound/soc/pic32/Kconfig
```kconfig
config SND_PIC32_SOC_I2S
	tristate

config SND_PIC32_SOC
	tristate "SoC Audio support for the Microchip PIC32"
	depends on MACH_PIC32
	select SND_SOC_DMAENGINE_PCM
	select DMA_PIC32
	select SND_SOC_GENERIC_DMAENGINE_PCM
	help
	  Say Y or M if you want to add support for codecs attached to
	  the PIC32 I2S interface. You will also need
	  to select the audio interfaces to support below.

config SND_PIC32_SOC_CODEC_PROTO
	tristate "Support for Audio Codec Board PROTO (WM8731)"
	depends on SND_PIC32_SOC
	select SND_PIC32_SOC_I2S
	select SND_SOC_WM8731
	help
	  Say Y if you want to add support for Audio Codec Board - PROTO
	  (WM8731) on PIC32.

config SND_PIC32_SOC_CODEC_AK4953A
	tristate "Support for Audio Codec AK4953A"
	depends on SND_PIC32_SOC
	select SND_PIC32_SOC_I2S
	select SND_SOC_AK4953
	help
	  Say Y if you want to add support for Audio Codec AK4953A on Microchip
	  PIC32.
```
