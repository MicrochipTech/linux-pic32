## Documentation/devicetree/bindings/mmc/sdhci-pic32.txt
```
* Microchip PIC32 SDHCI Controller

This file documents differences between the core properties in mmc.txt
and the properties used by the sdhci-pic32 driver.

Required properties:
- compatible: Should be "microchip,pic32-sdhci"
- reg: Should contain registers location and length
- interrupts: Should contain interrupt
- pinctrl: Should contain pinctrl for data and command lines

Optional properties:
- no-1-8-v: 1.8V voltage selection not supported
- piomode: disable DMA support

Example:

	sdhci@1f8ec000 {
		compatible = "microchip,pic32-sdhci";
		reg = <0x1f8ec000 0x100>;
		interrupts = <SDHC_EVENT DEFAULT_INT_PRI IRQ_TYPE_LEVEL_HIGH>;
		clocks = <&REFCLKO4>, <&PBCLK5>;
		clock-names = "base_clk", "sys_clk";
	};
```

## Documentation/devicetree/bindings/net/can/pic32_can.txt
```
* Microchip PIC32 CAN Controller Device Tree Bindings
-----------------------------------------------------

Required properties:
- compatible: Should be "microchip,pic32-can"
- reg: Should contain registers location and length
- interrupts: Should contain interrupt
- pinctrl: Should contain pinctrl for Tx, Rx and STBY(i.e Transreceiver enable/disable) lines
- clocks: Clock handles (see clock bindings for details).
- clock-names: List of input clock names - "can_clk"

Example:

Step1: SoC common .dtsi file

    can1: can@1f880000 {
        compatible = "microchip,pic32-can";
        reg = <0x1f880000 512>;
        interrupts = <CONTROL_AREA_NETWORK_1 DEFAULT_INT_PRI IRQ_TYPE_LEVEL_HIGH>;
        clocks = <&PBCLK5>;
        clock-names = "can_clk";
        status = "disabled";
    };

Step 2: board specific .dts file

	&can1 {
		pinctrl-names = "default";
		pinctrl-0 = <&pinctrl_can1>;
		transceiver-gpio = <&pioE 7 0>;
		status = "okay";
	};
```

## Documentation/devicetree/bindings/net/microchip,pic32-ec.txt
```
* PIC32 Ethernet Controller

Required properties:
- compatible: Should be "microchip,pic32-ec"
- reg: Address and length of the register-set (and optional,
       coherent-memory-region) for the device.
- reg-name: name of above "reg" property name. It must have "regs". Add
            "mem" if optional coherent-memory-region is available.
- interrupts: Should contain ethernet interrupt
- phy-mode: See ethernet.txt file in the same directory.
- clock-names: Single clock names.
	Required elements: 'eth_clk'
- clocks: Phandle to clock.

Optional properties:
- local-mac-address: Static MAC address.

Examples:

	pic32_ether: ethernet@1f882000 {
		compatible = "microchip,pic32-ec";
		reg = <0x1f882000 0x1000>,<0x1000 0x7f000>;
		reg-name= "regs","mem";
		interrupts = <ETHERNET_INTERRUPT DEFAULT_INT_PRI IRQ_TYPE_LEVEL_HIGH>;
		phy-mode = "rmii";
		local-mac-address = [00 00 00 00 00 00];
		clock-names = "eth_clk";
		clocks = <&PBCLK5>;
	};
```

## Documentation/devicetree/bindings/net/microchip,pic32_ether.txt
```
* PIC32 Ethernet Controller

Required properties:
- compatible: Should be "microchip,pic32-ether"
- reg: Address and length of the register-set (and optional,
       coherent-memory-region) for the device.
- reg-name: name of above "reg" property name. It must have "regs". Add
            "mem" if optional coherent-memory-region is available.
- interrupts: Should contain ethernet interrupt
- phy-mode: See ethernet.txt file in the same directory.
- clock-names: Single clock names.
	Required elements: 'eth_clk'
- clocks: Phandle to clock.

Examples:

	pic32_ether: ethernet@bf882000 {
		compatible = "microchip,pic32-ether";
		reg = <0xbf882000 0x1000>,<0x1000 0x7f000>;
		reg-name= "regs","mem";
		interrupts = <ETHERNET_INTERRUPT DEFAULT_INT_PRI IRQ_TYPE_LEVEL_HIGH>;
		phy-mode = "rmii";
		mac-address = [00 00 00 00 00 00];
		clock-names = "eth_clk";
		clocks = <&PBCLK5>;
	};
```

## Documentation/devicetree/bindings/net/wireless/csr,8811.txt
```
* CSR plc CSR8811 Bluetooth 4.1 module

The CRS8811 module can be connected via UART. The document describes the
binding for the UART connected chip.

Required properties:
- compatible :       		Should be "csr,8811"
- bluetooth_nrst-gpios :	Enable / reset gpio connected to the module

Examples:

bluetooth0 {
	compatible = "csr,8811";
	bluetooth_nrst-gpios = <&pioB 4 0>;
};
```

## Documentation/devicetree/bindings/pic32-regulator.txt
```
PIC32 voltage regulator bindings

Required properties:
- compatible: Should be "microchip,pic32-regulator"
- reg: register address-space.
- pic32,regulator-vin-select: input supply selector (0 or 1).
  Choose 0, for internal voltage sources (Vdd, Vss) and
  1, for external input voltage sources (Vref+, Vref-).
- pic32,regulator-vin-uV: input supply voltage (in microvolts). Select 3300000.
- pic32,regulator-vout-select: output voltage range selector.
  Choose 0 for [0.83V - 2.37V] and 1 for (0.00V - 2.06V)

Any property defined as part of the core regulator binding defined in
regulator.txt can also be used.

Example:
	cvref_regulator {
		compatible = "microchip,pic32-regulator;
		reg = <0x1f800e00 0x10>;

		/* specific */
		pic32,regulator-vin-select=<0>; /* input voltage supply selector */
		pic32,regulator-vin-uV=<3300000>; /* voltage supply */
		pic32,regulator-vout-select=<1>; /* output voltage range select */

		/* generic parameter */
		regulator-name="cvref_out";
		regulator-min-microvolt = <0140000>;
		regulator-max-microvolt = <2372000>;
		vref-supply=<&VREF_EXT>;
	};
```

## Documentation/devicetree/bindings/pinctrl/microchip,pic32-pinctrl.txt
```
* Microchip PIC32 Pinmux device.

Please refer to pinctrl-bindings.txt for details of the pinctrl properties and
common bindings.

PIC32 'pin configuration node' is a node of a group of pins which can be
used for a specific device or function. This node represents configuraions of
single pins or a pairs of mux and related configuration.

Required properties for pic32 device:
 - compatible: "microchip,pic32-pinctrl", "microchip,pic32mz-pinctrl"
 - reg: Base address and length for pps:in and pps:out registers.

Properties for 'pin configuration node':
 - pic32,pins: each entry consists of 3 intergers and represents the mux and
   config settings for one pin. The first integer represent the remappable pin,
   the second represent the peripheral pin and the last the configuration.
   The format is pic32,pins = <PIC32_RP_'dir'_'pin'
   PIC32_PP_'dir'_'peripherl-pin' PIC32_PIN_CONF_'config'>. The configurations
   are divided in 2 classes: IN and OUT and each in 4 buckets. Each entry must
   contains items from the same class and bucket, otherwise the driver will
   notify an error and the initialization will fail.
 - pic32,single-pins: each entry consists of 3 intergers and represents a pin
   (that is not remappable) and related configuraion. The format is
   pic32,single-pins = <PORT_'x' 'pin' PIC32_PIN_CONF_'config'>. Each port has
   32 pins and please refer to chip documentation for details of remappable
   pins.

Available pin configurations (refer to dt-bindings/pinctrl/pic32.h):
	PIC32_PIN_CONF_NONE	: no configuration (default).
	PIC32_PIN_CONF_OD	: indicate this pin need a open-drain (no direction).
	PIC32_PIN_CONF_OD_OUT	: indicate this pin need a open-drain out.
	PIC32_PIN_CONF_PU	: indicate this pin need a pull up (no direction).
	PIC32_PIN_CONF_PU_IN	: indicate this pin need a pull up in.
	PIC32_PIN_CONF_PD	: indicate this pin need a pull down (no direction).
	PIC32_PIN_CONF_PD_IN	: indicate this pin need a pull down input.
	PIC32_PIN_CONF_AN	: indicate this pin as analogic (no direction).
	PIC32_PIN_CONF_AN_IN	: indicate this pin as analogic input.
	PIC32_PIN_CONF_DG	: indicate this pin as digital (no direction).
	PIC32_PIN_CONF_DG_IN	: indicate this pin as digital input.
	PIC32_PIN_CONF_DG_OUT	: indicate this pin as digital output.

NOTEs:
1. The pins functions nods are defined under pic32 pinctrl node. The function's
   pin groups are defined under functions node.
2. Each pin group can have both pic32,pins and pic32,single-pins properties to
   specify re-mappable or non-remappable pins with related mux and configs or
   at least one.
3. Each pin configuration node can have a phandle and devices can set pins
   configurations by referring to the phandle of that pin configuration node.
4. The pinctrl bindings are listed in dt-bindings/pinctrl/pic32.h.
5. The gpio controller must be described in the pinctrl simple-bus.

Example:
pinctrl@1f800000{
	#address-cells = <1>;
	#size-cells = <1>;
	compatible = "microchip,pic32-pinctrl", "simple-bus";
	ranges;
	reg = <0x1f801404 0x3c>, /* in  */
	      <0x1f801538 0x57>; /* out */

	pioA: gpio@1f860000 {
		compatible = "microchip,pic32-gpio";
		reg = <0x1f860000 0x24>;
		gpio-controller;
	};

	/* functions */
	sw1 {
		pinctrl_sw1: sw1-0 {
			pic32,single-pins = <PORT_B 12 PIC32_PIN_CONF_PULLUP>;
		};
	};

	uart1 {
		pinctrl_uart1: uart1-0 {
			pic32,pins =
				<PIC32_RP_OUT_RPG7 PIC32_PP_OUT_U1TX PIC32_PIN_CONF_NONE
				 PIC32_RP_IN_RPG8 PIC32_PP_IN_U1RX PIC32_PIN_CONF_NONE>;
		};
	};
};

uart1: serial@1f822000 {
	compatible = "microchip,pic32-uart";

	pinctrl-names = "default";
	pinctrl-0 = <&pinctrl_uart1>;
};

sw@1 {
	compatible = "microchip,pic32-switch";

	interrupt-parent = <&pioB>;
	interrupts = <12 PIC32_CN_RISING>;/* GPIO_B_12 */

	pinctrl-names = "default";
	pinctrl-0 = <&pinctrl_sw1>;
};
```

## Documentation/devicetree/bindings/pwm/microchip,pic32-pwm.txt
```
* PIC32 Pulse Width Modulation

PWM functionality in Microchip PIC32 SoC is driven by Output Compare(OCMP)
module. OCMP module in congruence with General Purpose Timer(TIMER) module
generates PWM signal.

In PWM mode OCMP generates HIGH during duty_cycle and LOW when timer.count
exceeds duty_cycle. OCMP reloads duty_cycle when timer.count reaches PERIOD
and continues to drive HIGH.

Required properties:
- compatible : should be "microchip,pic32-pwm"
- #pwm-cells: should be 3. See pwm.txt in this directory for a description of
  the cells format. The only third cell flag supported by this binding is
  PWM_POLARITY_INVERTED.
- microchip,timer: pbtimer phandle.
- microchip,ocmp: ocmp phandle

Example:

pwm@0 {
	compatible = "microchip,pic32-pwm";
	microchip,timer = <&PBTIMER6>; /* pbtimer phandle */
	microchip,ocmp = <&OCMP2>; /* ocmp phandle */
};
```

## Documentation/devicetree/bindings/rng/microchip,rng.txt
```
* PIC32 Pseudo and True Random Number Generator

Required properties:

- compatible : should be "microchip,pic32-rng"
- reg : Specifies base physical address and size of the registers.
- clocks: clock phandle.

Example:

	rng: rng@1f8e6000 {
		compatible = "microchip,pic32-rng";
		reg = <0x1f8e6000 0x1000>;
		clocks = <&PBCLK5>;
	};
```

## Documentation/devicetree/bindings/rtc/microchip,pic32-rtc.txt
```
Microchip PIC32 Real Time Clock

Required properties:
- compatible: should be: "microchip,pic32-rtc"
- reg: physical base address of the controller and length of memory mapped
  region.
- interrupts: rtc alarm/event interrupt
- clocks: rtc clock

Example:

	rtc@1f8c0000 {
		compatible = "microchip,pic32-rtc";
		reg = <0x1f8c0000 0x60>;
		interrupts = <REAL_TIME_CLOCK DEFAULT_INT_PRI
				IRQ_TYPE_EDGE_RISING>;
		clocks = <&PBCLK6>;
	};
```

## Documentation/devicetree/bindings/serial/microchip,pic32-usart.txt
```
* Microchip Universal Synchronous Asynchronous Receiver/Transmitter (USART)

Required properties:
- compatible: Should be "microchip,pic32-usart"
- reg: Should contain registers location and length
- interrupts: Should contain interrupt
- pinctrl: Should contain pinctrl for TX/RX/RTS/CTS

Optional properties:
- microchip,uart-has-rtscts : Indicate the uart has hardware flow control
- rts-gpios: RTS pin for USP-based UART if microchip,uart-has-rtscts
- cts-gpios: CTS pin for USP-based UART if microchip,uart-has-rtscts

Example:
	usart0: serial@1f822000 {
		compatible = "microchip,pic32-usart";
		reg = <0x1f822000 0x50>;
		interrupts = <UART1_FAULT DEFAULT_INT_PRI IRQ_TYPE_NONE>,
			     <UART1_RECEIVE_DONE DEFAULT_INT_PRI IRQ_TYPE_NONE>,
			     <UART1_TRANSFER_DONE DEFAULT_INT_PRI IRQ_TYPE_NONE>;
		pinctrl-names = "default";
		pinctrl-0 = <
			&pinctrl_uart1
			&pinctrl_uart1_cts
			&pinctrl_uart1_rts>;
		microchip,uart-has-rtscts;
		cts-gpios = <&pioB 15 0>;
		rts-gpios = <&pioD 1 0>;
	};
```

## Documentation/devicetree/bindings/sound/ak4953a.txt
```
AK4953A Codec

This device supports I2C mode only.

Required properties:

  - compatible : "asahi-kasei,ak4953a"

  - reg : The I2C address of the chip

Optional properties:

  - reset-gpio : a GPIO spec for the reset pin. If specified, it will be
		 asserted before communication to the device starts.

Example:

ak4953a: ak4953a@12 {
	compatible = "asahi-kasei,ak4953a";
	reg = <0x12>;
};
```

## Documentation/devicetree/bindings/sound/microchip,pic32-i2s.txt
```
PIC32 SoC I2S Driver

Required properties:
- compatible : "microchip,pic32-i2s"
- reg : Should contain I2S registers location (physical address) and length
- interrupts : Should contain I2S receive and transmit interrupts
- dmas : Must contain an entry for each entry in clock-names.
  See ../dma/dma.txt for details.
- dma-names : Must include the following entries:
  - rx
  - tx
- clocks : Must contain one entry, for the module clock.
  See ../clocks/clock-bindings.txt for details.

Example:

	i2s0: i2s@1f821000 {
		compatible = "microchip,pic32-i2s";
		reg = <0x1f821000 512>;
		interrupts = <SPI1_RECEIVE_DONE DEFAULT_INT_PRI IRQ_TYPE_NONE>,
			<SPI1_TRANSFER_DONE DEFAULT_INT_PRI IRQ_TYPE_NONE>;
		dmas = <&dma 0>,
			<&dma 1>;
		dma-names = "rx", "tx";
		clocks = <&PBCLK2>;
	};
```

## Documentation/devicetree/bindings/sound/microchip,snd-pic32-ak4953a.txt
```
Microchip ASoC driver with AK4953A Codec

Required properties:
  - compatible: "microchip,snd-pic32-ak4953a"

    AK4953A pins:

    * MCKI
    * BICK
    * LRCK
    * SDTO
    * SDTI

  - microchip,cpu-dai: The phandle of I2S peripherals
  - microchip,audio-codec: The phandle of the AK4953A audio codec

Example:

	sound {
		compatible = "microchip,snd-pic32-ak4953a";
		microchip,cpu-dai = <&i2s1 &i2s2>;
		microchip,audio-codec = <&ak4953a>;
	};
```

## Documentation/devicetree/bindings/sound/microchip,snd-pic32-proto.txt
```
Microchip ASoC driver with WM8731 Proto Board

Required properties:
  - compatible: "microchip,snd-pic32-proto"

    WM8731 Proto pins:

    * SCK
    * MISO
    * MOSI
    * ADCL
    * DACL
    * SDA
    * SCL
    * 3.3V
    * GND

    Board connectors:

    * Headphone Jack
    * Mic Jack

  - microchip,cpu-dai: The phandle of I2S peripherals
  - microchip,audio-codec: The phandle of the WM8731 audio codec

Example:

	sound {
		compatible = "microchip,snd-pic32-proto";
		microchip,cpu-dai = <&i2s1 &i2s2>;
		microchip,audio-codec = <&wm8731>;
	};
```
