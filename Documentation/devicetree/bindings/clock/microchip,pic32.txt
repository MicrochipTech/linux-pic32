## Documentation/devicetree/bindings/spi/microchip,spi-pic32.txt
```
Microchip PIC32 SPI device

Required properties:
- compatible : should be "microchip,pic32-spi".
- reg: Address and length of the register set for the device
- interrupts: Should contain all three spi interrupts in sequence
              of <fault-irq>, <receive-irq>, <transmit-irq>.
- interrupt-names: Should be "fault","rx","tx" in order.
- cs-gpios:  Specifies the gpio pins to be used for chipselects.
- clocks: phandles of baud generation clocks. Maximum two possible clocks
	  can be provided (&PBCLK2, &REFCLKO1).
- clock-names: Should be "mck0"(for PBCLK2) ,"mck1"(for REFCLKO1).
- pinctrl: specify correct pinctrl name & pinctrl group.

Example:

spi1:spi@0xbf821000 {
        compatible = "microchip,pic32-spi";
        reg = <0x1f821000 0x200>;
        interrupt-parent = <&evic>;
        interrupts = <SPI1_FAULT DEFAULT_INT_PRI IRQ_TYPE_NONE>,
                     <SPI1_RECEIVE_DONE DEFAULT_INT_PRI IRQ_TYPE_NONE>,
                     <SPI1_TRANSFER_DONE DEFAULT_INT_PRI IRQ_TYPE_NONE>;
	interrupt-names = "fault","rx","tx";
        clocks = <&PBCLK2>,<&REFCLKO1>;
	clock-names = "ck0","ck1";
        pinctrl-names = "default";
        pinctrl-0 = <&pinctrl_spi1>;
        cs-gpios = <&pioD 4 0>;
        flash: m25p80@0 {
		#address-cells = <1>;
                #size-cells = <0>;
                compatible = "m25p80";
                spi-max-frequency = <25000000>;
                reg = <0>;
	};
};
```

## Documentation/devicetree/bindings/spi/sqi-pic32.txt
```
Microchip PIC32 SQI device

Required properties:
- compatible : should be "microchip,pic32-sqi".
- reg: Address and length of the register set for the device
- interrupts: Should contain sqi interrupt. Note SQI interrupt
              is level-triggerd one.
- clocks: phandles to input clocks. Should be &REFCLKO2, &PBCLK5 in order.
- clock-names: Should be "spi_ck" (for REFCLKO2) and "sfr_ck"(for PBCLK5).
- pinctrl: Specify correct pinctrl name & pinctrl group.

Optional properties:
- max-clock-frequency: SPI clock maximum output rate (in HZ)
- microchip,sqi-v1: Should be set for Michigan devices.
- microchip,sqi-num-cs: Number of chip-select lines to drive (default, 2).

Example:
	sqi1:spi@0xbf8e2000 {
		#address-cells = <1>;
		#size-cells = <0>;
		compatible = "microchip,pic32-sqi";
		reg = <0xbf8e2000 0x200>;
		clocks = <&REFCLKO2>, <&PBCLK5>;
		clock-names = "spi_ck","sfr_ck";
		interrupt-parent = <&evic>;
		interrupts = <SQI1_EVENT DEFAULT_INT_PRI IRQ_TYPE_LEVEL_HIGH>;
		pinctrl-names = "default";
		pinctrl-0 = <&pinctrl_sqi1>;
		max-clock-frequency = <5000000>;
	};
```

## Documentation/devicetree/bindings/timer/microchip,pic32-ocmp.txt
```
Microchip PIC32 output-compare

The PIC32 output-compare(OC) module can generate single pulse or train of pulses
in response to selected time bases and operating mode. This module is capable of
triggering ADC or asserting interrupt and working as PWM controller.

Required properties:
- compatible : should be "microchip,pic32-ocmp".
- reg : Specifies base address and size of the registers.
- interrupts : See evic ../interrupt-controller/.
- oc-id: module id (starting at 1) as documented in FRM.

Optional properties:
- microchip,oc-32bit : added only when 32bit timebase is used.
- microchip,oc-adc : OC can trigger an ADC.
- microchip,oc-pwm: OC as PWM controller.

Example:

ocmp1@0 {
	#oc-cells = <0>;
	compatible = "microchip,pic32-ocmp";
	reg = <0x1f844000 0x30>;
	interrupts = <0>;
	oc-id = <1>;
	microchip,oc-32bit; /* class B, 32-bit combined timer; usable for ADC */
	microchip,oc-pwm; /* PWM controller */
};

The output-compare consumers should specify the desire OC by having in its
"pic32,ocmp" phandle cell. For example for PWM

pwm-0: {
	compatible = <>;
	microchip,ocmp = <&ocmp1>; /* ocmp phandle */
};
```
