## Documentation/devicetree/bindings/clock/microchip,pic32.txt
```
Binding for a Clock hardware block found on
certain Microchip PIC32 MCU devices.

Microchip SoC clocks-node consists of few oscillators, PLL, multiplexer
and few divider nodes.

We will find only the base address of the clock tree, this base
address is common for some of the subnodes, not all. If no address is
specified for any of subnode base address of the clock tree will be
treated as its base. Each of subnodes follow the same common clock
binding with some additional optional properties.

	clocks_node {
		reg = <>;

		spll_node {
			...
		};

		frcdiv_node {
			...
		};

		sysclk_mux_node {
			...
		};

		pbdiv_node {
			...
		};

		refoclk_node {
			...
		};
		...
	};

This binding uses the common clock binding[1].

[1] Documentation/devicetree/bindings/clock/clock-bindings.txt

Required properties:
- compatible : should have "microchip,pic32-clk".
- reg : A Base address and length of the register set.
- interrupts : source of interrupt.

Optional properties (for subnodes):
- #clock-cells: From common clock binding, should be 0.

- microchip,clock-indices: in multiplexer node clock sources always aren't linear
    and contiguous. This property helps define clock-sources with respect to
    the mux clock node.

- microchip,ignore-unused : ignore gate request even if the gated clock is unused.
- microchip,status-bit-mask: bitmask for status check. This will be used to confirm
    particular operation by clock sub-node is completed. It is dependent sub-node.
- microchip,bit-mask: enable mask, similar to microchip,status-bit-mask.
- microchip,slew-step: enable frequency slewing(stepping) during rate change;
    applicable only to sys-clock subnode.

Example:

/* PIC32 specific clks */
pic32_clktree {
	#address-cells = <1>;
	#size-cells = <1>;
	reg = <0x1f801200 0x200>;
	compatible = "microchip,pic32-clk";
	interrupts = <12>;
	ranges;

	/* secondary oscillator; external input on SOSCI pin */
	SOSC:sosc_clk {
		#clock-cells = <0>;
		compatible = "microchip,pic32-sosc";
		clock-frequency = <32768>;
		reg = <0x1f801200 0x10   /* enable reg */
			0x1f801390 0x10>; /* status reg */
		microchip,bit-mask = <0x02>; /* enable mask */
		microchip,status-bit-mask = <0x10>; /* status-mask*/
	};

	FRCDIV:frcdiv_clk {
		#clock-cells = <0>;
		compatible = "microchip,pic32-frcdivclk";
		clocks = <&FRC>;
		clock-output-names = "frcdiv_clk";
	};

	/* System PLL clock */
	SYSPLL:spll_clk {
		#clock-cells = <0>;
		compatible = "microchip,pic32-syspll";
		reg = <0x1f801220 0x10 /* SPLL register */
			0x1f801390 0x10>; /* CLKSTAT register */
		clocks = <&POSC>, <&FRC>;
		clock-output-names = "sys_pll";
		microchip,status-bit-mask = <0x80>; /* SPLLRDY */
	};

	/* system clock; mux with postdiv & slew */
	SYSCLK:sys_clk {
		#clock-cells = <0>;
		compatible = "microchip,pic32-sysclk-v2";
		reg = <0x1f8013c0 0x04>; /* SLEWCON */
		clocks = <&FRCDIV>, <&SYSPLL>, <&POSC>, <&SOSC>,
				<&LPRC>, <&FRCDIV>;
		microchip,clock-indices = <0>, <1>, <2>, <4>, <5>, <7>;
		clock-output-names = "sys_clk";
	};

	/* DDR Ctrl & DDR PHY PLL */
	MPLL: CLK_MPLL {
		#clock-cells = <0>;
		compatible = "microchip,pic32-mpll";
		reg = <0x1f800100 0x04>; /* CFGMPLL */
		clocks = <&POSC>;
		clock-output-names = "pic32-mpll";
		status = "disabled";
	};

	/* Peripheral bus1 clock */
	PBCLK1:pb1_clk {
		reg = <0x1f801340 0x10>;
		#clock-cells = <0>;
		compatible = "microchip,pic32-pbclk";
		clocks = <&SYSCLK>;
		clock-output-names = "pb1_clk";
		/* used by system modules, not gateable */
		microchip,ignore-unused;
	};

	/* Peripheral bus2 clock */
	PBCLK2:pb2_clk {
		reg = <0x1f801350 0x10>;
		#clock-cells = <0>;
		compatible = "microchip,pic32-pbclk";
		clocks = <&SYSCLK>;
		clock-output-names = "pb2_clk";
		/* avoid gating even if unused */
		microchip,ignore-unused;
	};

	/* Peripheral bus3 clock */
	PBCLK3:pb3_clk {
		reg = <0x1f801360 0x10>;
		#clock-cells = <0>;
		compatible = "microchip,pic32-pbclk";
		clocks = <&SYSCLK>;
		clock-output-names = "pb3_clk";
	};

	/* Peripheral bus4 clock(I/O ports, GPIO) */
	PBCLK4:pb4_clk {
		reg = <0x1f801370 0x10>;
		#clock-cells = <0>;
		compatible = "microchip,pic32-pbclk";
		clocks = <&SYSCLK>;
		clock-output-names = "pb4_clk";
	};

	/* Peripheral bus clock */
	PBCLK5:pb5_clk {
		reg = <0x1f801380 0x10>;
		#clock-cells = <0>;
		compatible = "microchip,pic32-pbclk";
		clocks = <&SYSCLK>;
		clock-output-names = "pb5_clk";
	};

	/* Peripheral Bus6 clock; */
	PBCLK6:pb6_clk {
		reg = <0x1f801390 0x10>;
		compatible = "microchip,pic32-pbclk";
		clocks = <&SYSCLK>;
		#clock-cells = <0>;
	};

	/* Peripheral bus7 clock */
	PBCLK7:pb7_clk {
		reg = <0x1f8013A0 0x10>;
		#clock-cells = <0>;
		compatible = "microchip,pic32-pbclk";
		/* CPU is driven by this clock; so named */
		clock-output-names = "cpu_clk";
		clocks = <&SYSCLK>;
	};

	/* Reference Oscillator clock for SPI/I2S */
	REFCLKO1:refo1_clk {
		reg = <0x1f801280 0x20>;
		#clock-cells = <0>;
		compatible = "microchip,pic32-refoclk";
		clocks = <&SYSCLK>, <&PBCLK1>, <&POSC>, <&FRC>, <&LPRC>,
			<&SOSC>, <&SYSPLL>, <&REFIx>, <&BFRC>;
		microchip,clock-indices = <0>, <1>, <2>, <3>, <4>, <5>,
						<7>, <8>, <9>;
		clock-output-names = "refo1_clk";
		clock-frequency = <10000000>;  /* 10Mhz for I2S MCLK */
	};

	/* Reference Oscillator clock for SQI */
	REFCLKO2:refo2_clk {
		reg = <0x1f8012A0 0x20>;
		#clock-cells = <0>;
		compatible = "microchip,pic32-refoclk";
		clocks = <&SYSCLK>, <&PBCLK1>, <&POSC>, <&FRC>, <&LPRC>,
			<&SOSC>, <&SYSPLL>, <&REFIx>, <&BFRC>;
		microchip,clock-indices = <0>, <1>, <2>, <3>, <4>, <5>,
						<7>, <8>, <9>;
		clock-output-names = "refo2_clk";
		clock-frequency = <50000000>; /* 50MHz for SQI */
	};

	/* Reference Oscillator clock, ADC */
	REFCLKO3:refo3_clk {
		reg = <0x1f8012C0 0x20>;
		compatible = "microchip,pic32-refoclk";
		clocks = <&SYSCLK>, <&PBCLK1>, <&POSC>, <&FRC>, <&LPRC>,
			<&SOSC>, <&SYSPLL>, <&REFIx>, <&BFRC>;
		microchip,clock-indices = <0>, <1>, <2>, <3>, <4>, <5>,
						<7>, <8>, <9>;
		#clock-cells = <0>;
		clock-output-names = "refo3_clk";
		clock-frequency = <10000000>;  /* 1Mhz */
	};

	/* Reference Oscillator clock */
	REFCLKO4:refo4_clk {
		reg = <0x1f8012E0 0x20>;
		compatible = "microchip,pic32-refoclk";
		clocks = <&SYSCLK>, <&PBCLK1>, <&POSC>, <&FRC>, <&LPRC>,
				<&SOSC>, <&SYSPLL>, <&REFIx>, <&BFRC>;
		microchip,clock-indices = <0>,<1>,<2>,<3>,<4>,<5>,<7>,
						<8>,<9>;
		#clock-cells = <0>;
		clock-output-names = "refo4_clk";
		clock-frequency = <25000000>;  /* 25Mhz */
	};

	/* Reference Oscillator clock, LCD */
	REFCLKO5:refo5_clk {
		reg = <0x1f801300 0x20>;
		compatible = "microchip,pic32-refoclk";
		clocks = <&SYSCLK>,<&PBCLK1>,<&POSC>,<&FRC>,<&LPRC>,
			<&SOSC>,<&SYSPLL>,<&REFIx>,<&BFRC>;
		microchip,clock-indices = <0>, <1>, <2>, <3>, <4>, <5>,
					<7>, <8>,<9>;
		#clock-cells = <0>;
		clock-output-names = "refo5_clk";
		clock-frequency = <40000000>;  /* 40Mhz */
	};
};

The clock consumer should specify the desired clock by having the clocks in its
"clock" phandle cell. For example for UART:

uart2: serial@<> {
	compatible = "microchip,pic32-uart";
	reg = <>;
	interrupts = <>;
	clocks = <&PBCLK2>;
}
```

## Documentation/devicetree/bindings/dma/microchip,pic32-dma.txt
```
* PIC32 DMA Controller

The PIC32 DMA controller has 8 channels in total.
Each DMA channel is capable of
 - memory-to-device, device-to-memory and memory-to-memory transfer.
 - Automatic flow-control & abort based on peripheral interrupt sources.
 - One-Shot or Auto-Repeat Block Transfer.

Required properties:
- compatible: Should be "microchip,pic32-dma".
- reg: Should contain DMA registers location and length.
- interrupts: Should contain the DMA interrupts associated
		to the DMA channels in ascending order.
Example:

	dma: dma-controller@1f811000 {
		compatible = "microchip,pic32-dma";
		reg = <0x1f811000 0x2000>;
		interrupts = <DMA_CHANNEL_0 DEFAULT_INT_PRI
				IRQ_TYPE_EDGE_RISING>,
			<DMA_CHANNEL_1 DEFAULT_INT_PRI IRQ_TYPE_EDGE_RISING>,
			<DMA_CHANNEL_2 DEFAULT_INT_PRI IRQ_TYPE_EDGE_RISING>,
			<DMA_CHANNEL_3 DEFAULT_INT_PRI IRQ_TYPE_EDGE_RISING>,
			<DMA_CHANNEL_4 DEFAULT_INT_PRI IRQ_TYPE_EDGE_RISING>,
			<DMA_CHANNEL_5 DEFAULT_INT_PRI IRQ_TYPE_EDGE_RISING>,
			<DMA_CHANNEL_6 DEFAULT_INT_PRI IRQ_TYPE_EDGE_RISING>,
			<DMA_CHANNEL_7 DEFAULT_INT_PRI IRQ_TYPE_EDGE_RISING>;
		#dma-cells = <1>;
	};

DMA clients connected to the PIC32 DMA controller must use the format
described in the dma.txt file, using a two-cell specifier for each channel.

Each dma request consists of 2 cells:
 1. phandle pointing to the DMA controller
 2. DMA channel number.

Example:

	i2s1: i2s@1f821000 {
		compatible = "microchip,pic32-i2s";
		reg = <0x1f821000 0x200>;
		interrupts = <SPI1_RECEIVE_DONE DEFAULT_INT_PRI
				IRQ_TYPE_LEVEL_HIGH>,
			<SPI1_TRANSFER_DONE DEFAULT_INT_PRI
				IRQ_TYPE_LEVEL_HIGH>;
		dmas = <&dma DMA_CHANNEL_0>,
			<&dma DMA_CHANNEL_1>;
		dma-names = "rx", "tx";
		clocks = <&PBCLK2>, <&REFCLKO1>;
		clock-names = "mck0","mck1";
	};
```

## Documentation/devicetree/bindings/gpio/microchip,pic32-gpio.txt
```
* Microchip PIC32 GPIO devices (PIO).

Required properties:
 - compatible: "microchip,pic32-gpio"
 - reg: Base address and length for the device.
 - interrupts: The port interrupt shared be all pins.
 - gpio-controller: Marks the port as GPIO controller.
 - #gpio-cells: Two. The first cell is the pin number and
   the second cell is unused.
 - interrupt-controller: Marks the device node as an interrupt controller.
 - #interrupt-cells: Two. The first cell is the GPIO number and second cell
   is used to specify the trigger type:
	PIC32_PIN_CN_RISING	: low-to-high edge triggered.
	PIC32_PIN_CN_FALLING	: high-to-low edge triggered.
	PIC32_PIN_CN_BOTH	: low-to-high and high-to-low edges triggered.

Note:
 - If gpio-ranges is missing, then all the pins (32) related to the gpio bank
   are enabled.

Example:
	pioA: gpio@1f860000 {
		compatible = "microchip,pic32-gpio";
		reg = <0x1f860000 0x24>;
		interrupts = <PORTA_INPUT_CHANGE_INTERRUPT
				DEFAULT_INT_PRI IRQ_TYPE_LEVEL_HIGH>;
		#gpio-cells = <2>;
		gpio-controller;
		interrupt-controller;
		#interrupt-cells = <2>;
		gpio-ranges = <&pic32_pinctrl 0 0 32>;
		clocks = <&PBCLK4>;
	};
```

## Documentation/devicetree/bindings/i2c/microchip,pic32-i2c.txt
```
* Microchip PIC32 I2C Bus Driver

Required properties:
- compatible: Should be "microchip,pic32-i2c"
- reg: Should contain the address & size of the I2C controller registers.
- interrupts: Should specify the interrupt provided by parent.
- clocks: Should contain a single clock specifier for the JZ4780 I2C clock.
- clock-frequency: desired I2C bus clock frequency in Hz.

Recommended properties:
- pinctrl-names: should be "default";
- pinctrl-0: phandle to pinctrl function

Optional properties:
- interrupt-parent: Should be the phandle of the interrupt controller that
  delivers interrupts to the I2C block.

Example:

	i2c1: i2c@1f820000 {
		compatible = "microchip,pic32-i2c";
		reg = <0x1f820000 512>;
		interrupts = <I2C1_MASTER_EVENT DEFAULT_INT_PRI
				IRQ_TYPE_LEVEL_HIGH>;
		clock-frequency = <100000>;
		clocks = <&PBCLK2>;
		pinctrl-names = "default";
		pinctrl-0 = <&pinctrl_i2c1>;
		#address-cells = <1>;
		#size-cells = <0>;

		wm8731: wm8731@1a {
                        compatible = "wlf,wm8731";
                        reg = <0x1a>;
                };

		ak4953a: ak4953a@12 {
			compatible = "asahi-kasei,ak4953a";
			reg = <0x12>;
			reset-gpio = <&pioH 3 0>;
		};
	};
```

## Documentation/devicetree/bindings/iio/adc/pic32_adc.txt
```
* PIC32 Analog to Digital Converter (ADC)

Required properties:
  - compatible: Should be "microchip,pic32-adc"
  - reg: Should contain ADC registers location and length
  - interrupts: Should contain the IRQ line for the ADC
  - enabled-channel-mask: Bitmask of the channels that will be enabled
  - resolution: The desired adc resolution. Valid options are
    6, 8, 10 or 12 bits
  - vref: Reference voltage in millivolts for the conversions
Trigger Nodes:
  - trigger-name: Name of the trigger exposed to the user
  - trigger-value: Its associated value in the trigger register
  - microchip,timer: A handle for the associated timer trigger

Examples:
adc1: adc@1f84b000 {
	compatible = "microchip,pic32-adc";
	reg = <0x1f84b000 0x300>;
	interrupts = <ADC1_GLOBAL DEFAULT_INT_PRI IRQ_TYPE_LEVEL_HIGH>;
	pinctrl-names = "default";
	pinctrl-0 = <&pinctrl_adc1>;
	enabled-channel-mask = <0x1000001E>;
	resolution = <12>;
	vref = <3300>;

	trigger@0 {
		trigger-name = "int0-external-interrupt";
		trigger-value = <4>;
	};

	trigger@1 {
		trigger-name = "tmr1-match";
		trigger-value = <5>;
		microchip,timer = <&PBTIMER1>;
	};

	trigger@2 {
		trigger-name = "tmr3-match";
		trigger-value = <6>;
		microchip,timer = <&PBTIMER23>;
	};

	trigger@3 {
		trigger-name = "tmr5-match";
		trigger-value = <7>;
		microchip,timer = <&PBTIMER5>;
	};
};
```

## Documentation/devicetree/bindings/iio/microchip,iio-trig-pic32.txt
```
* PIC32 Periodic Timer ADC trigger.

Mandatory properties:
 - compatible : should be "microchip,pic32-timer-trig"
 - microchip,timer: phandle of Micorchip PB TIMER.

Optional properties:
 - trig-period-sec: trigger period in secs.

example:
iio-trig {
	compatible = "microchip,pic32-timer-trig";
	microchip,timer = <&PBTIMER23>;
	trig-period-sec = <2>;
};
```

## Documentation/devicetree/bindings/interrupt-controller/microchip,pic32mz-evic.txt
```
Microchip PIC32MZ Interrupt Controller
======================================

The Microchip PIC32MZ SOC contains an Enhanced Vectored Interrupt Controller
(EVIC) version 2. It handles internal and external interrupts and provides
support for priority, sub-priority, irq type and polarity.

Required properties
-------------------

- compatible: Should be "microchip,evic-v2"

- reg: specifies physical base address and size of register range.

- interrupt-controller: Identifies the node as an interrupt controller.

- #interrupt cells: Specifies the number of cells used to encode an interrupt
source connected to this controller. The value shall be 3 and interrupt
descriptor shall have the following format:
	<hw_irq irq_priority_and_subpriority irq_type>

hw_irq - represents the hardware interrupt number as in the data sheet.

irq_priority_and_subpriority - sets the priority and sub-priority for the
interrupt line. The INT_PRI(pri, subpri) macro can be used to set desired
values or the DEFAULT_INT_PRI can be used for the default value.

irq_type - is used to describe the type and polarity of an interrupt. For
internal interrupts use IRQ_TYPE_EDGE_RISING for non persistent interrupts and
IRQ_TYPE_LEVEL_HIGH for persistent interrupts. For external interrupts use
IRQ_TYPE_EDGE_RISING or IRQ_TYPE_EDGE_FALLING to select the desired polarity.

Example
-------

evic: interrupt-controller@1f810000 {
        compatible = "microchip,evic-v2";
        interrupt-controller;
        #interrupt-cells = <3>;
        reg = <0x1f810000 0x1000>;
        device_type="evic-v2";
};

Each device must request his interrupt line with the associated priority and
polarity

Internal interrupt DTS snippet
------------------------------

device@1f800000 {
	...
	interrupt-parent = <&evic>;
	interrupts = <UART1_RECEIVE_DONE DEFAULT_INT_PRI IRQ_TYPE_NONE>;
	...
};

External interrupt DTS snippet
------------------------------

device@1f800000 {
	...
	interrupt-parent = <&evic>;
	interrupts = <EXTERNAL_INTERRUPT_0 DEFAULT_INT_PRI IRQ_TYPE_EDGE_RISING>;
	...
};
```
